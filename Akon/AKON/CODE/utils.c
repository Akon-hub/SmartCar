#include "utils.h"

//一些工具类函数


int clip(int x, int low, int up) {
    return x > up ? up : x < low ? low : x;
}

float fclip(float x, float low, float up) {
    return x > up ? up : x < low ? low : x;
}



//整型限幅保护
int range_protect(int x, int x_min, int x_max)
{
	if(x >= x_max) return x_max;
	else if(x <= x_min) return x_min;
	//none
	return x;
}

//整型限幅保护
float range_protect_float(float x, float x_min, float x_max)
{
	if(x >= x_max) return x_max;
	else if(x <= x_min) return x_min;
	//none
	return x;
}

//整型绝对值
int ABS(int data)
{
  if(data <= 0)
    data = -data;
  
  return data;
}

float ABS_FLOAT(float data)
{
  if(data <= 0)
    data = -data;
  
  return data;
}
//delay_us
void delay_ms(unsigned short ms)
{
	systick_delay_ms(ms);
}


//============================================LCD==========================================================================================================================//


//============================================CAM==========================================================================================================================//
//一次函数连线
void lian_xian_zhi(int column1,int row1,int column2,int row2,int flag)
//a,b一队，de一队    a>b   两点之间连线    二次函数
{

    int i=0,ab=0,cd=0;
    for(i=row1; i>=row2; i--)
    {
        cd=(int)(  column2-column1)*(row1-i)/(row1-row2); //直线
        //cd=(column2-column1)*(row1-i)*(row1-i)/(row1-row2)/(row1-row2); //二次函数
        ab=(int)cd+column1;
        ab=range_protect(ab,159,0);
        if(flag==1)
        right_point[i].x=ab;
        if(flag==2)
        left_point[i].x=ab;

    }

}


const uint8 chinese[][16]=
{

		{0x02,0x00,0x02,0x00,0x02,0x00,0xFF,0xFE,0x04,0x00,0x04,0x00,0x04,0x00,0x08,0x00},
		{0x0F,0xF8,0x10,0x80,0x10,0x80,0x20,0x80,0x40,0x80,0x80,0x80,0x3F,0xFE,0x00,0x00},/*"左",0*/
		
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		{0x10,0xE0,0x11,0x50,0x12,0x48,0x14,0x44,0x10,0x40,0x28,0x00,0x47,0xFE,0x00,0x00},/*"速",4*/

};

const uint8 chinese1[][16]=
{

{0x20,0x40,0x3F,0x7E,0x48,0x90,0x85,0x08,0x3F,0xF8,0x01,0x08,0x01,0x08,0x3F,0xF8},
{0x21,0x00,0x21,0x00,0x3F,0xFC,0x03,0x04,0x05,0x04,0x19,0x28,0xE1,0x10,0x01,0x00},/*"第",0*/

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{0x55,0x10,0x55,0x10,0x91,0x10,0x11,0x12,0x11,0x12,0x12,0x12,0x12,0x0E,0x14,0x00},/*"机",6*/

};
